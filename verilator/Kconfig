## verilator/Kconfig
```kconfig
mainmenu "NPC Configuration Menu"

choice
  prompt "Base ISA"
  default ISA_riscv64
config ISA_riscv64
  bool "riscv64"
endchoice

config ISA
  string
  default "riscv64" if ISA_riscv64
  default "none"

config ISA64
  depends on ISA_riscv64
  bool
  default y


menu "Testing and Debugging"
config TRACE
  bool "Enable tracer"
  default y

config TRACE_START
  depends on TRACE
  int "When tracing is enabled (unit: number of instructions)"
  default 0

config TRACE_END
  depends on TRACE
  int "When tracing is disabled (unit: number of instructions)"
  default 10000

config ITRACE
  depends on TRACE
  bool "Enable instruction tracer"
  default y

config ITRACE_COND
  depends on ITRACE
  string "Only trace instructions when the condition is true"
  default "true"

config MTRACE
  depends on TRACE
  bool "Enable memory tracer"
  default y

config MTRACE_COND
  depends on MTRACE
  string "Only trace memory when the condition is true"
  default "true"

config FTRACE
  depends on TRACE
  bool "Enable frame tracer"
  default y

config FTRACE_COND
  depends on FTRACE
  string "Only trace frame when the condition is true"
  default "true"

config DTRACE
  depends on TRACE
  bool "Enable device tracer"
  default y

config DTRACE_COND
  depends on DTRACE
  string "Only trace device when the condition is true"
  default "true"

config WTRACE
  depends on TRACE
  bool "Enable wave tracer"
  default y

config WTRACE_COND
  depends on WTRACE
  string "Only trace wave when the condition is true"
  default "true"


config DIFFTEST
  bool "Enable differential testing"
  default n
  help
    Enable differential testing with a reference design.
    Note that this will significantly reduce the performance of NPC.

choice
  prompt "Reference design"
  default DIFFTEST_REF_NEMU
  depends on DIFFTEST
config DIFFTEST_REF_NEMU
  bool "NEMU"
endchoice

config DIFFTEST_REF_NAME
  string
  default "nemu" if DIFFTEST_REF_NEMU
  default "none"
endmenu

source "src/memory/Kconfig"
source "src/device/Kconfig"

menu "Miscellaneous"
choice
  prompt "Host timer"
  default TIMER_GETTIMEOFDAY
config TIMER_GETTIMEOFDAY
  bool "gettimeofday"
config TIMER_CLOCK_GETTIME
  bool "clock_gettime"
endchoice

config RT_CHECK
  bool "Enable runtime checking"
  default y

endmenu

config WATCHPOINT
  bool "Enable watchpoint"
  default n
```
